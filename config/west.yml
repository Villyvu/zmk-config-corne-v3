## config/west.yml
```yaml
manifest:
  defaults:
    revision: v0.3
  remotes:
    - name: zmkfirmware
      url-base: https://github.com/zmkfirmware
    - name: urob
      url-base: https://github.com/urob
    # Additional modules containing boards/shields/custom code can be listed here as well
    # See https://docs.zephyrproject.org/3.2.0/develop/west/manifest.html#projects
  projects:
    - name: zmk
      remote: zmkfirmware
      import: app/west.yml
    - name: ''
      url: https://github.com/joric/nrfmicro/
      revision: main
      path: modules/
    - name: zmk-tri-state       # smart Alt-Tab (swapper) behavior
      remote: urob
      revision: main
  self:
    path: config
```
